#define OLED_RESET     4
#define SCREEN_WIDTH 128
#define SCREEN_HEIGHT 32
#define LOGO_HEIGHT   128
#define LOGO_WIDTH    64
#define HEATTIME 5000
bool debug = true;
int stat = 0;
double heatTime = 0;

#include <iarduino_RF433_Receiver.h>                      // Подключаем библиотеку для работы с приёмником MX-RM-5V
#include <Adafruit_SSD1306.h>

void(* reset) (void) = 0;
Adafruit_SSD1306 display(SCREEN_WIDTH, SCREEN_HEIGHT, &Wire, OLED_RESET);

iarduino_RF433_Receiver radio(2);                         // Создаём объект radio для работы с библиотекой iarduino_RF433, указывая номер вывода к которому подключён приёмник (можно подключать только к выводам использующим внешние прерывания)
int                     data[2];                          // Создаём массив для приёма данных

const unsigned char PROGMEM logo_bmp [] = {
  0x00, 0x00, 0x00, 0x00, 0x00, 0x00, 0x00, 0x00, 0x00, 0x00, 0x00, 0x00, 0x00, 0x00, 0x00, 0x00,
  0x00, 0x18, 0x00, 0x00, 0x00, 0x00, 0x00, 0x00, 0x00, 0x00, 0x00, 0x00, 0x00, 0x00, 0x00, 0x00,
  0x00, 0x1c, 0x00, 0x00, 0x00, 0x00, 0x00, 0x00, 0x00, 0x00, 0x00, 0x00, 0x00, 0x00, 0x00, 0x00,
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  0x00, 0x00, 0x00, 0x00, 0x00, 0x00, 0x00, 0x00, 0x00, 0x00, 0x00, 0x00, 0x00, 0x00, 0x00, 0x00
};

void printDisplay(String str){
  display.clearDisplay();
  display.setTextSize(1);
  display.setCursor(0, 0);
  display.print((String)str +"\n" +stat);
  display.print(stat);
  display.display();
}

void setup(){
  pinMode(7, OUTPUT);
  Serial.begin(9600);
    radio.begin();                                        // Инициируем работу приёмника MX-RM-5V (в качестве параметра можно указать скорость ЧИСЛО бит/сек, тогда можно не вызывать функцию setDataRate)
    radio.setDataRate     (i433_1KBPS);                   // Указываем скорость приёма данных (i433_5KBPS, i433_4KBPS, i433_3KBPS, i433_2KBPS, i433_1KBPS, i433_500BPS, i433_100BPS), i433_1KBPS - 1кбит/сек
    radio.openReadingPipe (5);                            // Открываем 5 трубу для приема данных (если вызвать функцию без параметра, то будут открыты все трубы сразу, от 0 до 7)
//  radio.openReadingPipe (2);                            // Открываем 2 трубу для приёма данных (таким образом можно прослушивать сразу несколько труб)
//  radio.closeReadingPipe(2);                            // Закрываем 2 трубу от  приёма данных (если вызвать функцию без параметра, то будут закрыты все трубы сразу, от 0 до 7)
    radio.startListening  ();                             // Включаем приемник, начинаем прослушивать открытую трубу
//  radio.stopListening   ();                             // Выключаем приёмник, если потребуется

  if (!display.begin(SSD1306_SWITCHCAPVCC, 0x3C)) {
    for (;;);
  }
display.clearDisplay();
  display.drawBitmap(
    (display.width()  - 128 ) / 2,
    (display.height() - 32) / 2,
    logo_bmp, 128, 32, 1);
  display.setTextSize(1, 2);
  display.setTextColor(SSD1306_WHITE);
  display.setCursor(33, 0);
  display.print("POLOTSK");
   display.setTextSize(2, 4);
  display.setCursor(78, 1);
  display.print("GAS");
  display.display();
  delay(2000);
}
void loop(){

if(analogRead(A7) >300){
    digitalWrite(7,1);

   display.clearDisplay();
 
display.setTextSize(2, 2);
  display.setTextColor(SSD1306_WHITE);
  display.setCursor(0, 0);
  display.print("GAZ!!!");
   display.display();
}else{
   display.clearDisplay();
  display.display();
 // delay(100);
  display.setTextSize(5 );
  display.setCursor(0, 0);
    printDisplay("NO GAZ");
    digitalWrite(7,0);
}
  
    if(radio.available()){                                // Если в буфере имеются принятые данные
        radio.read(&data, sizeof(data));                  // Читаем данные в массив data и указываем сколько байт читать
        Serial.println(data[0]);   
double U = (data[0] / 1023.000) * 5.000; //409 - это значение напряжения 2 вольт
double Phigh = 6.000;
double Plow = 0.001;
double Uhigh = 2.000;
double Ulow = 0.400;
//double P = ((Phigh - Plow)/(Uhigh - Ulow)) * (U - Ulow) + Plow;//(7-4)*(4-0)/(20-4)=0.75МПа (Если зависимость линеиная, конечно)
double P = ((Phigh - Plow)/(Uhigh - Ulow)) * (U - Ulow);
//double P = ((U - Phigh)*(Ulow - Plow))/(Uhigh - Plow);
Serial.print(data[0]);
Serial.print(" = ");
Serial.println(U);

delay(50);
   //  display.clearDisplay();
   display.setTextSize(2);
  display.setCursor(0, 18);
 display.print("Pout: ");

    display.print(P);
  display.display();
  delay(1000);

    }                                                     // Если вызвать функцию available с параметром в виде ссылки на переменную типа uint8_t, то мы получим номер трубы, по которой пришли данные (см. урок 26.5)

}
